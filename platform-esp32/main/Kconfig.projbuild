## platform-esp32/main/Kconfig.projbuild
```kconfig
menu "RoboCup Agent Configuration"

    config ESP_WIFI_SSID
        string "WiFi SSID"
        default "WIFISSD"
        help
            SSID (network name) for the WiFi connection.

    config ESP_WIFI_PASSWORD
        string "WiFi Password"
        default "WIFIPassword"
        help
            WiFi password (WPA or WPA2).

    config MQTT_BROKER_URL
        string "MQTT Broker URL"
        default "mqtt://192.168.1.100:1883"
        help
            URL of the MQTT broker (format: mqtt://host:port).

endmenu
```

## platform-esp32/sdkconfig.defaults
```kconfig
# WiFi
CONFIG_ESP_WIFI_SSID="RoboCup_Network"
CONFIG_ESP_WIFI_PASSWORD="robocup2024"

# MQTT Broker
CONFIG_MQTT_BROKER_URL="mqtt://192.168.1.100:1883"

# Logging
CONFIG_LOG_DEFAULT_LEVEL_INFO=y

# FreeRTOS
CONFIG_FREERTOS_HZ=100
```
